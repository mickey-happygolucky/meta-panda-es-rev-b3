## conf/layer.conf
```bitbake
# We have a conf and classes directory, add to BBPATH
BBPATH .= ":${LAYERDIR}"

# We have recipes-* directories, add to BBFILES
BBFILES += "${LAYERDIR}/recipes-*/*/*.bb \
	${LAYERDIR}/recipes-*/*/*.bbappend"

BBFILE_COLLECTIONS += "meta-panda-es-rev-b3"
BBFILE_PATTERN_meta-panda-es-rev-b3 = "^${LAYERDIR}/"
BBFILE_PRIORITY_meta-panda-es-rev-b3 = "8"

LAYERDEPENDS_meta-panda-es-rev-b3 = "meta-ti"
```

## conf/machine/panda-es-rev-b3.conf
```bitbake
#@TYPE: Machine
#@NAME: Pandaboard ES Rev.B3
#@DESCRIPTION: Machine configuration for the OMAP4430 Panda ES Rev.B3

MACHINE_GUI_CLASS = "bigscreen"

IMAGE_FSTYPES += "tar.gz"

SERIAL_CONSOLE = "115200 ttyO2"

MACHINE_EXTRA_RRECOMMENDS = " kernel-modules"
MACHINE_FEATURES = "kernel26 wifi bluetooth alsa apm ext2 screen usbgadget usbhost vfat sgx"

SOC_FAMILY = "omap4"
require conf/machine/include/soc-family.inc

DEFAULTTUNE ?= "armv7athf-neon"
require conf/machine/include/tune-cortexa9.inc

PREFERRED_PROVIDER_virtual/kernel = "linux-panda-es-rev-b3"
PREFERRED_PROVIDER_virtual/bootloader = "u-boot-panda-es-rev-b3"
PREFERRED_PROVIDER_u-boot = "u-boot-panda-es-rev-b3"

PREFERRED_PROVIDER_virtual/xserver = "xserver-xorg"
XSERVER = "xserver-xorg \
           xserver-xorg-module-exa \
           xf86-input-evdev \
           xf86-video-omap"

# Increase this everytime you change something in the kernel
MACHINE_KERNEL_PR = "r0"

KERNEL_IMAGETYPE = "zImage"

UBOOT_MACHINE = "omap4_panda_config"

UBOOT_ENTRYPOINT = "0x80008000"
UBOOT_LOADADDRESS = "0x80008000"

EXTRA_IMAGEDEPENDS += "u-boot"
```
